## Kconfig
```kconfig
menu "Charge Indicator"

config CHARGE_INDICATOR
    bool "Enable charge status LED indicator"
    default n

config CHG_POLICY
    bool "Force off during charging (suppress widget)"
    default n
    help
      y: While charging, force LEDs OFF and suppress widget output.
      n: While charging, show selected color (CHG_COLOR) and suppress widget output.

config CHG_COLOR
    int "Charging color value (0-7)"
    range 0 7
    default 1
    help
      0 Black, 1 Red, 2 Green, 3 Yellow, 4 Blue, 5 Magenta, 6 Cyan, 7 White

endmenu
```
